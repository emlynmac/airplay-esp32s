## components/dac/Kconfig
```kconfig
menu "DAC Configuration"

    config DAC_TAS57XX
        bool "TI TAS57xx (TAS5754/TAS5756)"
        default n
        help
            Build the TI TAS5754M / TAS5756M DAC/amplifier driver.
            The board must register it at runtime via dac_register().

    config DAC_TAS58XX
        bool "TI TAS58xx (TAS5825M)"
        default n
        help
            Build the TI TAS5825M DAC/amplifier driver.
            The board must register it at runtime via dac_register().

    config DAC_ES8311
        bool "ESS ES8311 (stereo audio codec)"
        default n
        help
            Build the ES8311 stereo audio codec driver.
            The board must register it at runtime via dac_register().

    config DAC_PCM512X
        bool "TI PCM512x (PCM5121/PCM5122 line-out DAC)"
        default n
        help
            Build the TI PCM5121 / PCM5122 line-out DAC driver.
            The board must register it at runtime via dac_register().

            Same I2C addresses (0x4C-0x4F) and same page 0 register map as the
            TAS57xx, and neither part has a device ID register, so the two
            drivers cannot both be enabled and auto-detect at runtime.

    config DAC_CONTROLS_VOLUME
        bool
        default y if DAC_TAS57XX || DAC_TAS58XX || DAC_ES8311 || DAC_PCM512X
        help
            Hidden option. Set automatically when a hardware DAC driver is enabled.
            When true, the DAC handles volume control and software attenuation
            is skipped in the audio output path.

endmenu
```

## components/dac_pcm512x/Kconfig
```kconfig
if DAC_PCM512X

    config PCM512X_MAX_VOLUME
        int "Maximum DAC volume (dB)"
        range -100 0
        default 0
        help
            Maximum volume level in dB that corresponds to AirPlay volume 0 dB.
            The usable P0-R61/R62 range is 0 dB to -103 dB; the boost half of
            the register (up to +24 dB) is deliberately not used.

            Unlike the TAS57xx, a PCM512x drives a 2.1 Vrms line output rather
            than a speaker, so the default is 0 dB — full scale. Lower it if
            the amplifier downstream clips before the volume control reaches
            the top of its range.

    config PCM512X_ANALOG_GAIN_MINUS_6DB
        bool "Attenuate the line output by 6 dB"
        default n
        help
            Set P1-R2 LAGN/RAGN, dropping full scale from 2.1 Vrms to about
            1.05 Vrms. Useful when feeding an input that expects a 1 Vrms
            consumer line level. This is analogue attenuation, so it costs no
            resolution — prefer it over PCM512X_MAX_VOLUME for a fixed offset.

    config PCM512X_FORCE_BCK_PLL
        bool "Always derive the PLL from BCK"
        default n
        help
            By default the driver puts the PLL on MCLK when it detects one on
            the SCK pin, and falls back to BCK otherwise. Set this to keep the
            PLL on BCK even when MCLK is present.

            Only useful for testing the no-MCLK path on a board that has one.

endif
```

## components/dac_wm8711bl/Kconfig
```kconfig
if DAC_WM8711BL

    config DAC_WM8711BL_MAX_VOLUME
        int "Maximum DAC volume (dB)"
        range -73 6
        default 0
        help
            Maximum headphone output level in dB that corresponds to
            AirPlay volume 0 dB.  The WM8711BL register range is
            -73 dB to +6 dB (0 dB is the codec's unity-gain reference).
            A value of 0 means AirPlay full volume maps to the DAC's
            0 dB output level.

endif # DAC_WM8711BL
```
